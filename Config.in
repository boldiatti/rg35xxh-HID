## Config.in
```kconfig
source "$BR2_EXTERNAL_HID_FIRMWARE_PATH/package/rg35xxh-controller/Config.in"
source "$BR2_EXTERNAL_HID_FIRMWARE_PATH/package/rg35xxh-ui/Config.in"
```

## package/rg25xxh-ui/Config.in
```kconfig
config BR2_PACKAGE_RG35XXH_UI
    bool "rg35xxh-ui"
    depends on BR2_PACKAGE_SDL2
    depends on BR2_PACKAGE_SDL2_FBCON
    help
      Minimal UI for RG35XXH Controller showing status and button presses.
```

## package/rg35xxh-controller/config.in
```kconfig
config BR2_PACKAGE_RG35XXH_CONTROLLER
    bool "rg35xxh-controller"
    depends on BR2_PACKAGE_LIBEVDEV
    depends on BR2_PACKAGE_BLUEZ5_UTILS
    depends on BR2_PACKAGE_LIBUSB
    depends on BR2_PACKAGE_ALSA_LIB
    help
      RG35XXH Controller daemon for USB and Bluetooth HID gamepad emulation.
```

## patches/Config.in
```kconfig
source "$BR2_EXTERNAL_RG35XXH_PATH/package/rg35xxh-controller/Config.in"
source "$BR2_EXTERNAL_RG35XXH_PATH/package/rg35xxh-ui/Config.in"
```
